/*
 * Disable ethernet1 for power optimization
 */

/dts-v1/;
/plugin/;

/ {
	compatible = "rockchip,rk3506";

	fragment@0 {
		target = <&gmac1>;
		__overlay__ {
			status = "disabled";
		};
	};

	fragment@1 {
		target = <&mdio1>;
		__overlay__ {
			status = "disabled";
		};
	};
};
